## config/west.yml
```yaml
manifest:
  remotes:
    - name: zmkfirmware
      url-base: https://github.com/PartyDonut/
  projects:
    - name: zmk
      remote: zmk-old
      revision: zmk-split
      import: app/west.yml
  self:
    path: config
```
